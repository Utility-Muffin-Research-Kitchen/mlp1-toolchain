## br2-external/configs/mlp1_sdk_defconfig
```kconfig
# Architecture: Miniloong Pocket 1, Rockchip RK3566 / Cortex-A55.
BR2_aarch64=y
BR2_cortex_a55=y

# Internal Buildroot toolchain aligned to the observed stock firmware:
# glibc 2.38, GCC 12.3.0, Linux 5.10.x headers.
BR2_TOOLCHAIN_BUILDROOT_GLIBC=y
BR2_KERNEL_HEADERS_5_10=y
BR2_GCC_VERSION_12_X=y
BR2_TOOLCHAIN_BUILDROOT_CXX=y

# Keep the target filesystem minimal; this repo publishes the SDK/image, not
# a flashable firmware rootfs.
# BR2_TARGET_ROOTFS_TAR is not set

# First-pass UMRK runtime/link surface.
BR2_PACKAGE_ALSA_LIB=y
# PulseAudio is the device's mixer (it owns the rk817 codec); building it into
# the SDK gives RetroArch the libpulse client headers/.so so it can use the
# native `pulse` audio driver instead of the unreliable ALSA->Pulse shim.
BR2_PACKAGE_PULSEAUDIO=y
BR2_PACKAGE_FREETYPE=y
BR2_PACKAGE_FMT=y
BR2_PACKAGE_HARFBUZZ=y
BR2_PACKAGE_ICU=y
BR2_PACKAGE_INIH=y
BR2_PACKAGE_JSON_C=y
BR2_PACKAGE_JPEG=y
BR2_PACKAGE_CA_CERTIFICATES=y
BR2_PACKAGE_LIBCURL=y
BR2_PACKAGE_LIBCURL_OPENSSL=y
BR2_PACKAGE_LIBDRM=y
BR2_PACKAGE_LIBPNG=y
BR2_PACKAGE_MESA3D=y
BR2_PACKAGE_MESA3D_GALLIUM_DRIVER_PANFROST=y
BR2_PACKAGE_MESA3D_GBM=y
BR2_PACKAGE_MESA3D_OPENGL_EGL=y
BR2_PACKAGE_MESA3D_OPENGL_ES=y
BR2_PACKAGE_PIXMAN=y
BR2_PACKAGE_SDL2=y
BR2_PACKAGE_SDL2_KMSDRM=y
BR2_PACKAGE_SDL2_OPENGLES=y
BR2_PACKAGE_SDL2_IMAGE=y
BR2_PACKAGE_SDL2_TTF=y
BR2_PACKAGE_SQLITE=y
BR2_PACKAGE_SQLITE_ENABLE_FTS3=y
BR2_PACKAGE_SQLITE_ENABLE_JSON1=y
BR2_PACKAGE_OPENSSL=y
BR2_PACKAGE_WAYLAND=y
BR2_PACKAGE_WAYLAND_PROTOCOLS=y
BR2_PACKAGE_ZLIB=y
```
